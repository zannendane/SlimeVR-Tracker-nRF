## boards/zannen/zannensmol_uf2/board.yml
```yaml
# Copyright (c) 2024 Nordic Semiconductor ASA
# SPDX-License-Identifier: Apache-2.0

# ZannenSmol is a 1:1 replica of the SlimeVR official Smol ProMicro stacked solution.
# Variants with _clk suffix enable external IMU clock (for ICM45686 config),
# variants without _clk disable it (for LSM6DSV config).

board:
  name: zannensmol_uf2
  full_name: ZannenSmol
  vendor: zannen
  socs:
    - name: nrf52840
      variants:
      - name: 'i2c'
      - name: 'spi'
      - name: 'i2c_clk'
      - name: 'spi_clk'
```

## boards/zannen/zannensmol_uf2/zannensmol_uf2_defconfig
```kconfig
# Copyright (c) 2024 Nordic Semiconductor ASA
# SPDX-License-Identifier: Apache-2.0

CONFIG_ARM_MPU=y
CONFIG_HW_STACK_PROTECTION=y

CONFIG_USB_DEVICE_STACK=y
CONFIG_USB_DEVICE_MANUFACTURER="SlimeVR"
CONFIG_USB_DEVICE_PRODUCT="SlimeVR ZannenSmol"

CONFIG_BATTERY_USE_REG_LDO_MAPPING=y
CONFIG_SENSOR_ROTATION_270=y

#generate for adafruit uf2 bootloader flashing
CONFIG_BUILD_OUTPUT_UF2=y
CONFIG_FLASH_LOAD_OFFSET=0x1000

# ZannenSmol button layout: 1=Reset, 2=Calibration, 3=Mag Calibration, Hold=Deep Sleep
CONFIG_USER_EXTRA_ACTIONS=y
CONFIG_USER_SHUTDOWN=y
CONFIG_BUTTON_ZANNENSMOL_LAYOUT=y

# Enable magnetometer by default and auto-calibration
CONFIG_SENSOR_USE_MAG=y
CONFIG_MAG_AUTO_CALIBRATION=y
```

## boards/zannen/zannensmol_uf2/zannensmol_uf2_spi_clk_defconfig
```kconfig
# Copyright (c) 2024 Nordic Semiconductor ASA
# SPDX-License-Identifier: Apache-2.0

# ZannenSmol SPI variant (ICM45686 config, with external IMU clock, no magnetometer)

CONFIG_ARM_MPU=y
CONFIG_HW_STACK_PROTECTION=y

CONFIG_USB_DEVICE_STACK=y
CONFIG_USB_DEVICE_MANUFACTURER="SlimeVR"
CONFIG_USB_DEVICE_PRODUCT="SlimeVR ZannenSmol"

CONFIG_BATTERY_USE_REG_LDO_MAPPING=y
CONFIG_SENSOR_ROTATION_270=y

#generate for adafruit uf2 bootloader flashing
CONFIG_BUILD_OUTPUT_UF2=y
CONFIG_FLASH_LOAD_OFFSET=0x1000

# ZannenSmol button layout: 1=Reset, 2=Calibration, 3=Mag Calibration, Hold=Deep Sleep
CONFIG_USER_EXTRA_ACTIONS=y
CONFIG_USER_SHUTDOWN=y
CONFIG_BUTTON_ZANNENSMOL_LAYOUT=y

# Disable magnetometer (SPI variant has no I2C bus for mag)
CONFIG_SENSOR_USE_MAG=n

# Enable external clock (ICM45686 config)
CONFIG_USE_SENSOR_CLOCK=y
```
