## Kconfig
```kconfig
#
# Copyright (c) 2023 Nordic Semiconductor
#
# SPDX-License-Identifier: LicenseRef-Nordic-5-Clause
#

config USE_SLIMENRF_CONSOLE
    bool "Use basic console"
    default y
    help
        Use basic console for commands.

config BATTERY_CHARGER_HAS_NTC
    bool "Battery thermistor"
    help
      Flag for battery NTC thermistor availability.

choice
    prompt "Battery voltage mapping"
    default BATTERY_NO_MAPPING

config BATTERY_USE_REG_BUCK_MAPPING
    bool "Use buck regulator mapping (3.7V battery, DCDC)"
    help
      Use a constant power mapping for battery voltage.
      Preffered for systems with a buck regulator.
      Measured at a system voltage of 3.0V.

config BATTERY_USE_REG_LDO_MAPPING
    bool "Use LDO linear regulator mapping (3.7V battery, LDO)"
    help
      Use a constant current mapping for battery voltage.
      Preferred for systems with a linear regulator.

config BATTERY_NO_MAPPING
    bool "Disable battery voltage mapping"
    help
      Always map to 100% battery. Disables battery monitoring.

endchoice

config BATTERY_LOW_RUNTIME_THRESHOLD
    int "Low battery runtime threshold (ms)"
    default 10800000
    help
      Trigger low battery when estimated runtime falls below threshold.
      If estimated runtime is not available, low battery will trigger under 10% estimated state of charge.

config BATTERY_ADC_GAIN_DIVISOR
    int "Battery ADC gain divisor override"
    default 0
    range 0 6
    help
      Force the SAADC gain used for battery measurement, given as the
      divisor of the gain (e.g. 5 selects 1/5 gain, 3.0V full scale).
      0 selects the gain automatically from the divider ratio.

config BATTERY_ADC_RESOLUTION
    int "Battery ADC resolution (bits)"
    default 14
    range 8 14

config BATTERY_ADC_OVERSAMPLING
    int "Battery ADC oversampling exponent (samples averaged = 2^n)"
    default 7
    range 0 8

config BATTERY_ADC_ACQUISITION_US
    int "Battery ADC acquisition time (us)"
    default 3
    help
      SAADC acquisition (TACQ) time in microseconds.
      Valid values for nRF52 SAADC: 3, 5, 10, 15, 20, 40.

config BATTERY_MEASURE_SETTLE_MS
    int "Battery divider settling time before sampling (ms)"
    default 0
    help
      Delay between enabling the battery divider power switch and
      sampling the ADC, allowing the divider output buffer to settle.

config BATTERY_SAMPLE_INTERVAL_MS
    int "Battery voltage sampling interval (ms)"
    default 100
    range 100 3600000
    help
      Interval between battery voltage measurements. The power thread
      cycles every 100 ms, so 100 means every cycle (original behavior).
      Battery voltage changes slowly, a longer interval saves the power
      drawn by the divider and the ADC with no practical downside.

choice
    prompt "Status LED color mapping"
    default LED_TRI_COLOR

config LED_RGB_COLOR
    bool "Use RGB color mapping"
    help
        Use RGB or RG color mapping for LED status if available.

config LED_TRI_COLOR
    bool "Use default color mapping"
    help
        Use the default color mapping for LED status.

endchoice

menu "Status LED default status color"
    depends on LED_RGB_COLOR

config LED_DEFAULT_COLOR_R
    int "Red value"
    range 0 10000
    default 4000
    depends on LED_RGB_COLOR
    help
        Red color for default status.
        Valid range is 0 to 10000.

config LED_DEFAULT_COLOR_G
    int "Green value"
    range 0 10000
    default 6000
    depends on LED_RGB_COLOR
    help
        Green color for default status.
        Valid range is 0 to 10000.

config LED_DEFAULT_COLOR_B
    int "Blue value"
    range 0 10000
    default 0
    depends on LED_RGB_COLOR
    help
        Blue color for default status.
        Valid range is 0 to 10000.

endmenu

config USER_EXTRA_ACTIONS
    bool "Multiple press actions"
    help
        Allow user to use multiple presses to calibrate, pair, or enter DFU.
        By default, pairing is available when holding down sw0 for 5 seconds.
        By default, DFU is available when holding down sw0 and plugging in a USB cable.

config BUTTON_ZANNENSMOL_LAYOUT
    bool "ZannenSmol button layout"
    help
        Use ZannenSmol-specific SW0 button layout:
        1 press = Reset, 2 presses = Calibration,
        3 presses = Magnetometer Calibration,
        Press and hold for 2s = Deep Sleep.

config USE_IMU_TAP
    bool "Use IMU tap detection as user input"
    help
        Detect taps on the tracker from the accelerometer stream and treat
        them like button presses: 2 taps = calibration, 3 taps = pairing
        reset, 4 or more taps = DFU (same mapping as reset counting).
        Taps are detected in software while the system is active, so this
        works at any ODR and in every sensor power mode. In IMU wake up
        (WOM) state any tap is motion and already wakes the system, no
        additional configuration is needed there.

config IMU_TAP_THRESHOLD
    int "Tap detection threshold (mg)"
    default 600
    depends on USE_IMU_TAP
    help
        Dynamic acceleration above the gravity baseline required to start
        registering a tap. Raise if handling the tracker triggers taps.

config IMU_TAP_GYRO_GATE
    int "Tap detection gyroscope gate (dps)"
    default 60
    depends on USE_IMU_TAP
    help
        Ignore taps while the tracker is rotating faster than this,
        rejects most false detections during use.

config MAG_AUTO_CALIBRATION
    bool "Magnetometer auto-calibration"
    help
        Automatically start magnetometer calibration when calibration data
        is empty or invalid at boot. Also prints progress logs to the console
        during magnetometer calibration.

config MAG_IGNORE_WHILE_CHARGING
    bool "Ignore magnetometer while charging"
    depends on SENSOR_USE_MAG
    help
        Suspend magnetometer reads and fusion updates while the battery is
        charging. Charge current flowing near the magnetometer disturbs the
        magnetic field, ignoring it avoids polluting the fusion's local
        field reference. Heading is tracked by the gyroscope alone while
        charging and resumes seamlessly afterwards.

config IGNORE_RESET
    bool "Ignore reset"
    default y
    help
        If sw0 is available, don't perform any extra actions on reset.

config USER_SHUTDOWN
    bool "User shutdown support"
    default y
    help
        Allow user to use reset or sw0 to shutdown.

config USE_IMU_WAKE_UP
    bool "IMU wake up support"
    default y
    help
        Use IMU wake up state if IMU wake up is present.

config DELAY_SLEEP_ON_STATUS
    bool "Delay IMU wake up mode on status flags"
    default y
    depends on USE_IMU_WAKE_UP
    help
        Delay IMU wake up state if there is an active status flag or in pairing mode.

config WOM_USE_DCDC
    bool "Use DCDC in IMU wake up mode"
    depends on USE_IMU_WAKE_UP
    help
        Use DCDC instead of LDO in IMU wake up state if it is more efficient.

config WOM_ACCEL_ODR
    int "WOM accelerometer output data rate (Hz)"
    default 240
    range 15 480
    depends on USE_IMU_WAKE_UP
    help
        Accelerometer ODR used in IMU wake up (WOM) state, rounded down
        to the nearest supported rate. A lower rate reduces WOM current
        consumption at the cost of slower motion detection latency.
        Currently applied to LSM6DSV(16X) only.

config CONNECTION_TIMEOUT_DELAY
    int "Connection timeout delay (ms)"
    default 300000
    depends on USER_SHUTDOWN
    help
        Cumulative awake time without a receiver connection before
        shutting down. The accumulated time is kept in retained memory
        and survives IMU wake up (WOM) cycles, so it measures total
        disconnected time rather than one continuous stretch.

choice
    prompt "Sensor rotation"
    default SENSOR_ROTATION_90

config SENSOR_ROTATION_0
    bool "0 degrees"

config SENSOR_ROTATION_90
    bool "90 degrees"

config SENSOR_ROTATION_180
    bool "180 degrees"

config SENSOR_ROTATION_270
    bool "270 degrees"

config SENSOR_ROTATION_0_FLIPPED
    bool "0 degrees flipped"

config SENSOR_ROTATION_90_FLIPPED
    bool "90 degrees flipped"

config SENSOR_ROTATION_180_FLIPPED
    bool "180 degrees flipped"

config SENSOR_ROTATION_270_FLIPPED
    bool "270 degrees flipped"

config SENSOR_ROTATION_CUSTOM
    bool "Custom angles"

config SENSOR_ROTATION_CUSTOM_X
    int "Custom rotation around X axis (degrees)"
    default 0
    range -360 360
    depends on SENSOR_ROTATION_CUSTOM
    help
        Custom mounting rotation, applied as roll (X) first, then pitch (Y),
        then yaw (Z), same composition order as the flipped presets.
        Positive angles follow the right-hand rule around the positive axis,
        so a clockwise yaw seen from above is negative.

config SENSOR_ROTATION_CUSTOM_Y
    int "Custom rotation around Y axis (degrees)"
    default 0
    range -360 360
    depends on SENSOR_ROTATION_CUSTOM

config SENSOR_ROTATION_CUSTOM_Z
    int "Custom rotation around Z axis (degrees)"
    default 0
    range -360 360
    depends on SENSOR_ROTATION_CUSTOM

endchoice

menu "Sensor power saving"

config SENSOR_LP_TIMEOUT
    int "Sensor low power delay (ms)"
    default 500
    help
        Low power timeout during no motion.

config SENSOR_USE_LOW_POWER_2
    bool "Use additional low power modes"
    help
        Use a higher latency sensor mode during no motion.

config USE_IMU_TIMEOUT
    bool "Use IMU wake up state"
    default y
    depends on USE_IMU_WAKE_UP
    help
        Use IMU wake up state during no motion.

config IMU_TIMEOUT_RAMP_MIN
    int "Sensor timeout minimum delay (ms)"
    default 5000
    depends on USE_IMU_TIMEOUT || SENSOR_USE_LOW_POWER_2
    help
        Minimum timeout during no motion. Initial period on wake up.

config IMU_TIMEOUT_RAMP_MAX
    int "Sensor timeout maximum delay (ms)"
    default 15000
    depends on USE_IMU_TIMEOUT || SENSOR_USE_LOW_POWER_2
    help
        Maximum timeout during no motion.

config USE_ACTIVE_TIMEOUT
    bool "Use activity timeout"
    default y
    depends on USE_IMU_WAKE_UP || USER_SHUTDOWN
    help
        Delay IMU wake up state or user shutdown during activity.

choice
    prompt "Activity timeout mode"
    default SLEEP_ON_ACTIVE_TIMEOUT
    depends on USE_ACTIVE_TIMEOUT

config SLEEP_ON_ACTIVE_TIMEOUT
    bool "IMU wake up"
    depends on USE_IMU_WAKE_UP
    help
        Use IMU wake up state when activity timeout elapses.

config SHUTDOWN_ON_ACTIVE_TIMEOUT
    bool "User shutdown"
    depends on USER_SHUTDOWN
    help
        Use user shutdown when activity timeout elapses.

endchoice

config ACTIVE_TIMEOUT_THRESHOLD
    int "Activity timeout threshold (ms)"
    default 15000
    depends on USE_ACTIVE_TIMEOUT
    help
        Trigger activity timeout after a certain threshold of activity.

config ACTIVE_TIMEOUT_DELAY
    int "Activity timeout delay (ms)"
    default 900000
    depends on USE_ACTIVE_TIMEOUT
    help
        Activity timeout duration when triggered.

endmenu

config SENSOR_ACCEL_ODR
    int "Accelerometer output data rate (Hz)"
    default 100
    help
        Requested accelerometer output data rate. Actual rate will be raised to the nearest supported rate.
        A higher rate will increase the time to read and process sensor data.

config SENSOR_GYRO_ODR
    int "Gyrometer output data rate (Hz)"
    default 200
    help
        Requested gyrometer output data rate. Actual rate will be raised to the nearest supported rate.
        A higher rate will increase the time to read and process sensor data.
        A lower rate is recommended for IMUs with poor gyrometer rate noise density. (e.g. BMI270, LSM6DS3TR-C)

config SENSOR_ACCEL_FS
    int "Accelerometer full scale (g)"
    default 4
    help
        Requested accelerometer full scale. Actual scale will be raised to the nearest supported scale.
        A lower scale may improve noise performance, but is more likely to saturate.

config SENSOR_GYRO_FS
    int "Gyrometer full scale (dps)"
    default 1000
    help
        Requested gyrometer full scale. Actual scale will be raised to the nearest supported scale.
        A lower scale may improve noise performance, but is more likely to saturate.

config SENSOR_USE_MAG
    bool "Magnetometer support"
    default y
    help
        Use magnetometer if it is present.

config USE_SENSOR_CLOCK
    bool "Use external IMU clock"
    default y
    help
        Use external IMU clock if it is present.

choice
    prompt "Sensor fusion"
    default SENSOR_USE_VQF
    help
        Select the sensor fusion method.

config SENSOR_USE_VQF
    bool "Use VQF"
    help
        Use VQF for sensor fusion.
        Based on Kalman filter.

endchoice

config SENSOR_USE_6_SIDE_CALIBRATION
    bool "Use 6-side calibration"
    default y
    depends on USE_SLIMENRF_CONSOLE
    help
        Use 6-side calibration for accelerometer.
        Calibration can be completed through the basic console.

config RADIO_TX_POWER
    int "Radio output power (dBm)"
    default 8
    help
        Radio output power level.
        A lower value may reduce power consumption.

config CONNECTION_OVER_HID
    bool "Use HID for data output"
    help
        Use HID if available.
        Otherwise, use ESB only.

source "Kconfig.zephyr"
```
